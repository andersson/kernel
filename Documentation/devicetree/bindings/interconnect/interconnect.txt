## Documentation/devicetree/bindings/interconnect/interconnect.txt
```
Interconnect Provider Device Tree Bindings
=========================================

The purpose of this document is to define a common set of generic interconnect
providers/consumers properties.


= interconnect providers =

The interconnect provider binding is intended to represent the interconnect
controllers in the system. Each provider registers a set of interconnect
nodes, which expose the interconnect related capabilities of the interconnect
to consumer drivers. These capabilities can be throughput, latency, priority
etc. The consumer drivers set constraints on interconnect path (or endpoints)
depending on the usecase. Interconnect providers can also be interconnect
consumers, such as in the case where two network-on-chip fabrics interface
directly

Required properties:
- compatible : contains the interconnect provider vendor specific compatible
	       string
- reg : register space of the interconnect controller hardware
- #interconnect-cells : number of cells in a interconnect specifier needed to
		       encode the interconnect node id.

Example:

		snoc: snoc@0580000 {
			compatible = "qcom,msm8916-snoc";
			reg = <0x580000 0x14000>;
			#interconnect-cells = <1>;
			clock-names = "bus_clk", "bus_a_clk";
			clocks = <&rpmcc RPM_SMD_SNOC_CLK>, <&rpmcc RPM_SMD_SNOC_A_CLK>;
			status = "okay";
		};
		bimc: bimc@0400000 {
			compatible = "qcom,msm8916-bimc";
			reg = <0x400000 0x62000>;
			#interconnect-cells = <1>;
			clock-names = "bus_clk", "bus_a_clk";
			clocks = <&rpmcc RPM_SMD_BIMC_CLK>, <&rpmcc RPM_SMD_BIMC_A_CLK>;
			status = "okay";
		};
		pnoc: pnoc@500000 {
			compatible = "qcom,msm8916-pnoc";
			reg = <0x500000 0x11000>;
			#interconnect-cells = <1>;
			clock-names = "bus_clk", "bus_a_clk";
			clocks = <&rpmcc RPM_SMD_PCNOC_CLK>, <&rpmcc RPM_SMD_PCNOC_A_CLK>;
			status = "okay";
		};

= interconnect consumers =

The interconnect consumers are device nodes which consume the interconnect
path(s) provided by the interconnect provider. There can be multiple
interconnect providers on a SoC and the consumer may consume multiple paths
from different providers depending on usecase and the components it has to
interact with.

Required-properties:
interconnect-src : A phandle and interconnect provider specifier as defined by
		bindings of the interconnect provider specified by phandle.
		This denotes the source device port which will be used, as the
		device may have multiple master ports.
interconnect-dst : A phandle and internet provider specifier pointing to the
		local port of the target device.

Example:

	sdhci@07864000 {
		...
		interconnect-src = <&pnoc MAS_PNOC_SDCC_2>;
		interconnect-dst = <&pnoc SLV_BLSP_1>;
	};
```

## Documentation/devicetree/bindings/interconnect/qcom-msm8996.txt
```
Qualcomm MSM8996 Network-On-Chip interconnect driver binding
----------------------------------------------------

Required properties :
- compatible : shall contain only one of the following:
			"qcom,msm8996-a0noc"
			"qcom,msm8996-a1noc"
			"qcom,msm8996-a2noc"
			"qcom,msm8996-bimc"
			"qcom,msm8996-cnoc"
			"qcom,msm8996-mmnoc"
			"qcom,msm8996-snoc"
			"qcom,msm8996-pnoc"
- #interconnect-cells : should contain 1
- reg : shall contain base register location and length

Optional properties :
clocks : list of phandles and specifiers to all interconnect bus clocks
clock-names : clock names should include both "bus_clk" and "bus_a_clk"

Examples:

                bimc: bimc@400000 {
                        compatible = "qcom,msm8996-bimc";
                        #interconnect-cells = <1>;
                        reg = <0x400000 0x62000>;
                        clock-names = "bus_clk", "bus_a_clk";
                        clocks = <&rpmcc RPM_SMD_BIMC_CLK>,
                                 <&rpmcc RPM_SMD_BIMC_A_CLK>;
                };

		cnoc: cnoc@500000 {
                        compatible = "qcom,msm8996-cnoc";
                        #interconnect-cells = <1>;
                        reg = <0x500000 0x80>;
                        clock-names = "bus_clk", "bus_a_clk";
                        clocks = <&rpmcc RPM_SMD_CNOC_CLK>,
                                 <&rpmcc RPM_SMD_CNOC_A_CLK>;
                };

                snoc: snoc@520000 {
                        compatible = "qcom,msm8996-snoc";
                        #interconnect-cells = <1>;
                        reg = <0x520000 0xa100>;
                        clock-names = "bus_clk", "bus_a_clk";
                        clocks = <&rpmcc RPM_SMD_SNOC_CLK>,
                                 <&rpmcc RPM_SMD_SNOC_A_CLK>;
                };

                a0noc: a0noc@540000 {
                        compatible = "qcom,msm8996-a0noc";
                        #interconnect-cells = <1>;
                        reg = <0x540000 0x5100>;
                        clock-names = "bus_clk", "bus_a_clk";
                        clocks = <&gcc GCC_AGGRE0_SNOC_AXI_CLK>,
                                 <&gcc GCC_AGGRE0_SNOC_AXI_CLK>;
                        power-domains = <&gcc AGGRE0_NOC_GDSC>;
                };

                a1noc: a1noc@560000 {
                        compatible = "qcom,msm8996-a1noc";
                        #interconnect-cells = <1>;
                        reg = <0x560000 0x3100>;
                        clock-names = "bus_clk", "bus_a_clk";
                        clocks = <&rpmcc RPM_SMD_AGGR1_NOC_CLK>,
                                 <&rpmcc RPM_SMD_AGGR1_NOC_A_CLK>;
                };

                a2noc: a2noc@580000 {
                        compatible = "qcom,msm8996-a2noc";
                        #interconnect-cells = <1>;
                        reg = <0x580000 0x8100>;
                        clock-names = "bus_clk", "bus_a_clk";
                        clocks = <&rpmcc RPM_SMD_AGGR2_NOC_CLK>,
                                 <&rpmcc RPM_SMD_AGGR2_NOC_A_CLK>;
                };

                mmnoc: mmnoc@5a0000 {
                        compatible = "qcom,msm8996-mmnoc";
                        #interconnect-cells = <1>;
                        reg = <0x5a0000 0xb080>;
                        clock-names = "bus_clk", "bus_a_clk";
                        clocks = <&rpmcc RPM_SMD_MMAXI_CLK>,
                                 <&rpmcc RPM_SMD_MMAXI_A_CLK>;
                        power-domains = <&mmcc MMAGIC_BIMC_GDSC>;
                };

                pnoc: pnoc@5c0000 {
                        compatible = "qcom,msm8996-pnoc";
                        #interconnect-cells = <1>;
                        reg = <0x5c0000 0x2480>;
                        clock-names = "bus_clk", "bus_a_clk";
                        clocks = <&rpmcc RPM_SMD_PCNOC_CLK>,
                                 <&rpmcc RPM_SMD_PCNOC_A_CLK>;
                };
```

## Documentation/devicetree/bindings/media/qcom,venus.txt
```
* Qualcomm Venus video encode/decode accelerator

- compatible:
	Usage: required
	Value type: <stringlist>
	Definition: Value should contain one of:
		- "qcom,msm8916-venus"
		- "qcom,msm8996-venus"
- reg:
	Usage: required
	Value type: <prop-encoded-array>
	Definition: Register ranges as listed in the reg-names property.
- reg-names:
	Usage: required
	Value type: <stringlist>
	Definition: Should contain following entries:
		- "base"	Venus register base
- interrupts:
	Usage: required
	Value type: <prop-encoded-array>
	Definition: Should contain interrupts as listed in the interrupt-names
		    property.
- interrupt-names:
	Usage: required
	Value type: <stringlist>
	Definition: Should contain following entries:
		- "venus"	Venus interrupt line
- clocks:
	Usage: required
	Value type: <prop-encoded-array>
	Definition: A List of phandle and clock specifier pairs as listed
		    in clock-names property.
- clock-names:
	Usage: required
	Value type: <stringlist>
	Definition: Should contain the following entries:
		- "core"	Core video accelerator clock
		- "iface"	Video accelerator AHB clock
		- "bus"		Video accelerator AXI clock
- clock-names:
	Usage: required for msm8996
	Value type: <stringlist>
	Definition: Should contain the following entries:
		- "subcore0"		Subcore0 video accelerator clock
		- "subcore1"		Subcore1 video accelerator clock
		- "mmssnoc_axi"		Multimedia subsystem NOC AXI clock
		- "mmss_mmagic_iface"	Multimedia subsystem MMAGIC AHB clock
		- "mmss_mmagic_mbus"	Multimedia subsystem MMAGIC MAXI clock
		- "mmagic_video_bus"	MMAGIC video AXI clock
		- "video_mbus"		Video MAXI clock
- power-domains:
	Usage: required
	Value type: <prop-encoded-array>
	Definition: A phandle and power domain specifier pairs to the
		    power domain which is responsible for collapsing
		    and restoring power to the peripheral.
- rproc:
	Usage: required
	Value type: <prop-encoded-array>
	Definition: A phandle to remote processor responsible for
		    firmware loading and processor booting.

- iommus:
	Usage: required
	Value type: <prop-encoded-array>
	Definition: A list of phandle and IOMMU specifier pairs.

* An Example
	video-codec@1d00000 {
		compatible = "qcom,msm8916-venus";
		reg = <0x01d00000 0xff000>;
		reg-names = "base";
		interrupts = <GIC_SPI 44 IRQ_TYPE_LEVEL_HIGH>;
		interrupt-names = "venus";
		clocks = <&gcc GCC_VENUS0_VCODEC0_CLK>,
			 <&gcc GCC_VENUS0_AHB_CLK>,
			 <&gcc GCC_VENUS0_AXI_CLK>;
		clock-names = "core", "iface", "bus";
		power-domains = <&gcc VENUS_GDSC>;
		rproc = <&venus_rproc>;
		iommus = <&apps_iommu 5>;
	};
```

## Documentation/devicetree/bindings/opp/qcom-opp.txt
```
Qualcomm OPP bindings to descibe OPP nodes with corner/level values

OPP tables for devices on Qualcomm platforms require an additional
platform specific corner/level value to be specified.
This value is passed on to the RPM (Resource Power Manager) by
the CPU, which then takes the necessary actions to set a voltage
rail to an appropriate voltage based on the value passed.

The bindings are based on top of the operating-points-v2 bindings
described in Documentation/devicetree/bindings/opp/opp.txt
Additional properties are described below.

* OPP Table Node

Required properties:
- compatible: Allow OPPs to express their compatibility. It should be:
  "operating-points-v2-qcom-level"

* OPP Node

Required properties:
- qcom,level: On Qualcomm platforms an OPP node can describe a positive value
representing a corner/level that's communicated with a remote microprocessor
(usually called the RPM) which then translates it into a certain voltage on
a voltage rail.
```

## Documentation/devicetree/bindings/phy/qcom-msm8996-pcie-phy.txt
```
Qualcomm msm8996 pcie PHY Controller
------------------------------------

pcie PHY nodes are defined to describe on-chip pcie Physical layer controllers.
Each pcie PHY controller should have its own node.

Required properties:
- compatible: compatible list, contains "qcom,msm8996-pcie-phy".
- reg: offset and length of the pcie PHY register set;
- #phy-cells: must be zero
- clocks: a list of phandles and clock-specifier pairs, one for each entry in
  clock-names.
- clock-names: must be "cfg" for phy config clock.

Example:
	pcie_phy: pcie-phy@1b400000 {
		compatible = "qcom,msm8996-pcie-phy";
		reg = <0x1b400000 0x200>;

		clocks = <&gcc pcie_PHY_CFG_CLK>;
		clock-names = "cfg";

		#phy-cells = <0>;
	};
```

## Documentation/devicetree/bindings/phy/qcom-qmp-phy.txt
```
Qualcomm QMP PHY controller
===========================

QMP phy controller supports physical layer functionality for a number of
controllers on Qualcomm chipsets, such as, PCIe, UFS, and USB.

Required properties:
 - compatible: compatible list, contains:
	       "qcom,msm8996-qmp-pcie-phy" for 14nm PCIe phy on msm8996,
	       "qcom,msm8996-qmp-usb3-phy" for 14nm USB3 phy on msm8996.
 - reg: list of offset and length pair of the PHY register sets.
	at index 0: offset and length of register set for PHY common
		    serdes block.
	from index 1 - N: offset and length of register set for each lane,
			  for N number of phy lanes (ports).
 - lane-offsets: array of offsets to tx, rx and pcs blocks for phy lanes.
 - #phy-cells: must be 1
    - Cell after phy phandle should be the port (lane) number.
 - #clock-cells: must be 1
    - Phy pll outputs a bunch of clocks for Tx, Rx and Pipe
      interface (for pipe based PHYs). These clock are then gate-controlled
      by gcc.
 - clocks: a list of phandles and clock-specifier pairs,
	   one for each entry in clock-names.
 - clock-names: must be "cfg_ahb" for phy config clock,
			"aux" for phy aux clock,
			"ref" for 19.2 MHz ref clk,
			"pipe<port-number>" for pipe clock specific to
			each port/lane (Optional).
 - resets: a list of phandles and reset controller specifier pairs,
	   one for each entry in reset-names.
 - reset-names: must be "phy" for reset of phy block,
			"common" for phy common block reset,
			"cfg" for phy's ahb cfg block reset (Optional).
			"port<port-number>" for reset specific to
			each port/lane (Optional).
 - vdda-phy-supply: Phandle to a regulator supply to PHY core block.
 - vdda-pll-supply: Phandle to 1.8V regulator supply to PHY refclk pll block.

Optional properties:
 - vddp-ref-clk-supply: Phandle to a regulator supply to any specific refclk
			pll block.

Example:
	pcie_phy: phy@34000 {
		compatible = "qcom,msm8996-qmp-pcie-phy";
		reg = <0x034000 0x48f>,
			<0x035000 0x5bf>,
			<0x036000 0x5bf>,
			<0x037000 0x5bf>;
				/* tx, rx, pcs */
		lane-offsets = <0x0 0x200 0x400>;
		#phy-cells = <1>;
		#clock-cells = <1>;

		clocks = <&gcc GCC_PCIE_PHY_AUX_CLK>,
			<&gcc GCC_PCIE_PHY_CFG_AHB_CLK>,
			<&gcc GCC_PCIE_CLKREF_CLK>,
			<&gcc GCC_PCIE_0_PIPE_CLK>,
			<&gcc GCC_PCIE_1_PIPE_CLK>,
			<&gcc GCC_PCIE_2_PIPE_CLK>;
		clock-names = "aux", "cfg_ahb", "ref",
				"pipe0", "pipe1", "pipe2";

		vdda-phy-supply = <&pm8994_l28>;
		vdda-pll-supply = <&pm8994_l12>;

		resets = <&gcc GCC_PCIE_PHY_BCR>,
			<&gcc GCC_PCIE_PHY_COM_BCR>,
			<&gcc GCC_PCIE_PHY_COM_NOCSR_BCR>,
			<&gcc GCC_PCIE_0_PHY_BCR>,
			<&gcc GCC_PCIE_1_PHY_BCR>,
			<&gcc GCC_PCIE_2_PHY_BCR>;
		reset-names = "phy", "common", "cfg",
				"lane0", "lane1", "lane2";
	};
```

## Documentation/devicetree/bindings/pinctrl/qcom,wcd934x-pinctrl.yaml
```yaml
# SPDX-License-Identifier: (GPL-2.0 OR BSD-2-Clause)
%YAML 1.2
---
$id: http://devicetree.org/schemas/pinctrl/qcom,wcd934x-pinctrl.yaml#
$schema: http://devicetree.org/meta-schemas/core.yaml#

title: WCD9340/WCD9341 GPIO Pin controller

maintainers:
  - Srinivas Kandagatla <srinivas.kandagatla@linaro.org>

description: |
  Qualcomm Technologies Inc WCD9340/WCD9341 Audio Codec has integrated
  gpio controller to control 5 gpios on the chip.

properties:
  compatible:
    enum:
      - qcom,wcd9340-pinctrl
      - qcom,wcd9341-pinctrl

  reg:
    maxItems: 1

  gpio-controller: true

  gpio-ranges:
    maxItems: 1

  '#gpio-cells':
    const: 2

required:
  - compatible
  - reg
  - gpio-controller
  - gpio-ranges
  - "#gpio-cells"

additionalProperties: false

examples:
  - |
    wcdpinctrl: pinctrl@42 {
        compatible = "qcom,wcd9340-pinctrl";
        reg = <0x042 0x2>;
        gpio-controller;
        gpio-ranges = <&wcdpinctrl 0 0 5>;
        #gpio-cells = <2>;
    };

...
```
