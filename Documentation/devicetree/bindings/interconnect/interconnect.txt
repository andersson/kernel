## Documentation/devicetree/bindings/soc/qcom/qcom,apr.txt
```
Qualcomm APR (Asynchronous Packet Router) binding

This binding describes the Qualcomm APR. APR is a IPC protocol for
communication between Application processor and QDSP. APR is mainly
used for audio/voice services on the QDSP.

- compatible:
	Usage: required
	Value type: <stringlist>
	Definition: must be "qcom,apr-v<VERSION-NUMBER>", example "qcom,apr-v2"

- qcom,apr-dest-domain-id
	Usage: required
	Value type: <prop-encoded-array>
	Definition: Destination processor ID.
	Possible values are :
			1 - APR simulator
			2 - PC
			3 - MODEM
			4 - ADSP
			5 - APPS
			6 - MODEM2
			7 - APPS2

= APR SERVICES
Each subnode of the APR node can represent service tied to this apr. The name
of the nodes are not important. The properties of these nodes are defined
by the individual bindings for the specific service
- but must contain the following property:

- qcom,apr-svc-id
	Usage: required
	Value type: <prop-encoded-array>
	Definition: APR Service ID, used for matching the service.
	Possible values are :
			3 - DSP Core Service
			4 - Audio Front End Service.
			5 - Voice Stream Manager Service.
			6 - Voice processing manager.
			7 - Audio Stream Manager Service.
			8 - Audio Device Manager Service.
			9 - Multimode voice manager.
			10 - Core voice stream.
			11 - Core voice processor.
			12 - Ultrasound stream manager.
			13 - Listen stream manager.

- qcom,apr-svc-name
	Usage: required
	Value type: <stringlist>
	Definition: User readable name of a APR service.

= APR DEVICES:
Each subnode of the APR node can represent devices tied to this apr, like
sound-card. The properties of these nodes are defined by the individual
bindings for the specific device.

= EXAMPLE
The following example represents a QDSP based sound card on a MSM8996 device
which uses apr as communication between Apps and QDSP.

	apr {
		compatible = "qcom,apr-v2";
		qcom,smd-channels = "apr_audio_svc";
		qcom,apr-dest-domain-id = <APR_DOMAIN_ADSP>;

		q6core {
			compatible = "qcom,q6core";
			qcom,apr-svc-name = "CORE";
			qcom,apr-svc-id = <APR_SVC_ADSP_CORE>;
		};

		q6afe {
			compatible = "qcom,q6afe";
			qcom,apr-svc-name = "AFE";
			qcom,apr-svc-id = <APR_SVC_AFE>;
		};

		audio {
			compatible = "qcom,msm8996-snd-card";
			...
		};
	};
```

## Documentation/devicetree/bindings/soc/qcom/qcom,rfsa.txt
```
Qualcomm Remote File System Access binding

This binding describes the Qualcomm RFSA, which serves the purpose of managing
the shared memory region used for remote processors to access block device data
using the Remote Filesystem protocol.

- compatible:
	Usage: required
	Value type: <stringlist>
	Definition: must be:
		    "qcom,rfsa"

- memory-region:
	Usage: required
	Value type: <prop-encoded-array>
	Definition: handle to memory reservation the associated rfsa region.

- qcom,client-id:
	Usage: required
	Value type: <u32>
	Definition: identifier of the client to use this region for buffers.

= EXAMPLE
The following example shows the RFSA setup for APQ8016, with the RFSA region
for the Hexagon DSP (id #1) located at 0x86700000.

	reserved-memory {
		#address-cells = <2>;
		#size-cells = <2>;
		ranges;

		rmtfs: rmtfs@86700000 {
			reg = <0x0 0x86700000 0x0 0xe0000>;
			no-map;
		};
	};

	hexagon-rfsa {
		compatible = "qcom,rfsa";
		memory-region = <&rmtfs>;

		qcom,client-id = <1>;
	};
```

## Documentation/devicetree/bindings/sound/qcom,apq8096.txt
```
* Qualcomm Technologies APQ8096 ASoC sound card driver

This binding describes the APQ8096 sound card, which uses qdsp for audio.

- compatible:
	Usage: required
	Value type: <stringlist>
	Definition: must be "qcom,apq8096-sndcard"

- qcom,audio-routing:
	Usage: Optional
	Value type: <stringlist>
	Definition:  A list of the connections between audio components.
		  Each entry is a pair of strings, the first being the
		  connection's sink, the second being the connection's
		  source. Valid names could be power supplies, MicBias
		  of codec and the jacks on the board:

= FRONTEND and BACKEND dailinks
Each subnode of sndcard represents either frontend or backend dailink,
and subnodes of each backend/frontend dailinks would be
cpu/codec/platform dais.

- link-name:
	Usage: required
	Value type: <string>
	Definition: User friendly name for dai link

- is-fe:
	Usage: optional
	Value type: <bool>
	Definition: present if the dailink is frontend


= CPU, PLATFORM, CODEC dais subnodes
- cpu:
	Usage: required
	Value type: <subnode>
	Definition: cpu dai sub-node

- codec:
	Usage: required
	Value type: <subnode>
	Definition: codec dai sub-node

- platform:
	Usage: opional
	Value type: <subnode>
	Definition: platform dai sub-node

- sound-dai:
	Usage: required
	Value type: <phandle>
	Definition: dai phandle/s and port of CPU/CODEC/PLATFORM node.

Example:

audio {
	compatible = "qcom,apq8096-sndcard";
	qcom,model = "DB820c";
	qcom,audio-routing =
		"RX_BIAS", "MCLK";

	fedai1 {
		is-fe;
		link-name = "MultiMedia1 Playback";
		cpu {
			sound-dai = <&q6asm  MSM_FRONTEND_DAI_MULTIMEDIA1>;
		};
		platform {
			sound-dai = <&q6asm  MSM_FRONTEND_DAI_MULTIMEDIA1>;
		};
	};

	bedai1 {
		link-name = "HDMI Playback";
		cpu {
			sound-dai = <&q6afe AFE_PORT_HDMI_RX>;
		};

		platform {
			sound-dai = <&q6adm>;
		};

		codec {
			sound-dai = <&hdmi 0>;
		};
	};
};
```

## Documentation/devicetree/bindings/sound/qcom,q6adm.txt
```
Qualcomm Audio Device Manager (Q6ADM) binding

Q6ADM is one of the APR audio service on Q6DSP.
Please refer to qcom,apr.txt for details of the coommon apr service bindings
used by the apr service device.

- but must contain the following property:

- compatible:
	Usage: required
	Value type: <stringlist>
	Definition: must be "qcom,adm-v<MAJOR-NUMBER>.<MINOR-NUMBER>".
		    example "qcom,adm-v2.0"

- qcom,apr-svc-id
	Usage: required
	Value type: <prop-encoded-array>
	Definition: Must be 8 for Audio Device Manager Service.

- qcom,apr-svc-name
	Usage: required
	Value type: <stringlist>
	Definition: Must be "ADM"

= EXAMPLE

q6adm: q6adm {
	compatible = "qcom,q6adm-v2.0";
	qcom,apr-svc-name = "ADM";
	qcom,apr-svc-id = <APR_SVC_ADM>;
};
```

## Documentation/devicetree/bindings/sound/qcom,q6afe.txt
```
Qualcomm Audio Front End (Q6AFE) binding

AFE is one of the APR audio service on Q6DSP
Please refer to qcom,apr.txt for details of the coommon apr service bindings
used by the apr service device.

- but must contain the following property:

- compatible:
	Usage: required
	Value type: <stringlist>
	Definition: must be "qcom,afe-v<MAJOR-NUMBER>.<MINOR-NUMBER>".
		    example "qcom,afe-v2.0"

- qcom,apr-svc-id
	Usage: required
	Value type: <prop-encoded-array>
	Definition: Must be 4 for Audio Front End Service.

- qcom,apr-svc-name
	Usage: required
	Value type: <stringlist>
	Definition: Must be "AFE"

- #sound-dai-cells
	Usage: required
	Value type: <prop-encoded-array>
	Definition: Must be 1


= EXAMPLE

q6afe {
	compatible = "qcom,q6afe";
	qcom,apr-svc-name = "AFE";
	qcom,apr-svc-id = <APR_SVC_AFE>;
	#sound-dai-cells = <1>;
};
```

## Documentation/devicetree/bindings/sound/qcom,q6asm.txt
```
Qualcomm Audio Stream Manager (Q6ASM) binding

Q6ASM is one of the APR audio service on Q6DSP.
Please refer to qcom,apr.txt for details of the coommon apr service bindings
used by the apr service device.

- but must contain the following property:

- compatible:
	Usage: required
	Value type: <stringlist>
	Definition: must be "qcom,asm-v<MAJOR-NUMBER>.<MINOR-NUMBER>".
		    example "qcom,asm-v2.0"

- qcom,apr-svc-id
	Usage: required
	Value type: <prop-encoded-array>
	Definition: Must be 7 for Audio Stream Manager Service.

- qcom,apr-svc-name
	Usage: required
	Value type: <stringlist>
	Definition: Must be "ASM"

- #sound-dai-cells
	Usage: required
	Value type: <prop-encoded-array>
	Definition: Must be 1


= EXAMPLE

q6asm: q6asm {
	compatible = "qcom,q6asm";
	qcom,apr-svc-name = "ASM";
	qcom,apr-svc-id = <APR_SVC_ASM>;
	#sound-dai-cells = <1>;
};
```

## Documentation/devicetree/bindings/sound/qcom,wcd934x.yaml
```yaml
# SPDX-License-Identifier: (GPL-2.0-only OR BSD-2-Clause)
%YAML 1.2
---
$id: http://devicetree.org/schemas/sound/qcom,wcd934x.yaml#
$schema: http://devicetree.org/meta-schemas/core.yaml#

title: Bindings for Qualcomm WCD9340/WCD9341 Audio Codec

maintainers:
  - Srinivas Kandagatla <srinivas.kandagatla@linaro.org>

description: |
  Qualcomm WCD9340/WCD9341 Codec is a standalone Hi-Fi audio codec IC.
  It has in-built Soundwire controller, pin controller, interrupt mux and
  supports both I2S/I2C and SLIMbus audio interfaces.

properties:
  compatible:
    const: slim217,250

  reg:
    maxItems: 1

  interrupts:
    maxItems: 1

  reset-gpios:
    description: GPIO spec for reset line to use
    maxItems: 1

  slim-ifc-dev:
    description: SLIMBus Interface device phandle
    maxItems: 1

  clocks:
    maxItems: 1

  clock-names:
    const: extclk

  vdd-buck-supply:
    description: A reference to the 1.8V buck supply

  vdd-buck-sido-supply:
    description: A reference to the 1.8V SIDO buck supply

  vdd-rx-supply:
    description: A reference to the 1.8V rx supply

  vdd-tx-supply:
    description: A reference to the 1.8V tx supply

  vdd-vbat-supply:
    description: A reference to the vbat supply

  vdd-io-supply:
    description: A reference to the 1.8V I/O supply

  vdd-micbias-supply:
    description: A reference to the micbias supply

  qcom,micbias1-millivolt:
    description: Voltage betwee 1800mv-2850mv for micbias1 output
    allOf:
      - $ref: /schemas/types.yaml#/definitions/uint32

  qcom,micbias2-millivolt:
    description: Voltage betwee 1800mv-2850mv for micbias2 output
    allOf:
      - $ref: /schemas/types.yaml#/definitions/uint32

  qcom,micbias3-millivolt:
    description: Voltage betwee 1800mv-2850mv for micbias3 output
    allOf:
      - $ref: /schemas/types.yaml#/definitions/uint32

  qcom,micbias4-millivolt:
    description: Voltage betwee 1800mv-2850mv for micbias4 output
    allOf:
      - $ref: /schemas/types.yaml#/definitions/uint32

  clock-output-names:
    const: mclk

  clock-frequency:
    description: Clock frequency of output clk in Hz

  interrupt-controller: true

  '#interrupt-cells':
    const: 1

  '#clock-cells':
    const: 0

  '#sound-dai-cells':
    const: 1

  "#address-cells":
    const: 1

  "#size-cells":
    const: 1

patternProperties:
  "^.*@[0-9a-f]+$":
    type: object
    description: |
      WCD934x subnode for each slave devices. Bindings of each subnodes
      depends on the specific driver providing the functionality and
      documented in there respective bindings.

    properties:
      reg:
        maxItems: 1

    required:
      - reg

required:
  - compatible
  - reg
  - reset-gpios
  - slim-ifc-dev
  - interrupts
  - interrupt-controller
  - clock-frequency
  - clock-output-names
  - qcom,micbias1-millivolt
  - qcom,micbias2-millivolt
  - qcom,micbias3-millivolt
  - qcom,micbias4-millivolt
  - "#interrupt-cells"
  - "#clock-cells"
  - "#sound-dai-cells"
  - "#address-cells"
  - "#size-cells"

examples:
  - |
    codec@1,0{
        compatible = "slim217,250";
        reg  = <1 0>;
        reset-gpios = <&tlmm 64 0>;
        slim-ifc-dev  = <&wcd9340_ifd>;
        #sound-dai-cells = <1>;
        interrupt-parent = <&tlmm>;
        interrupts = <54 4>;
        interrupt-controller;
        #interrupt-cells = <1>;
        #clock-cells = <0>;
        clock-frequency = <9600000>;
        clock-output-names = "mclk";
        qcom,micbias1-millivolt = <1800>;
        qcom,micbias2-millivolt = <1800>;
        qcom,micbias3-millivolt = <1800>;
        qcom,micbias4-millivolt = <1800>;
        clock-names = "extclk";
        clocks = <&rpmhcc 2>;

        #address-cells = <1>;
        #size-cells = <1>;

        wcdpinctrl@42 {
            reg = <0x42 0x2>;
        };
    };

...
```

## drivers/interconnect/qcom/Kconfig
```kconfig
config INTERCONNECT_QCOM
	bool "Qualcomm Network-on-Chip interconnect drivers"
	depends on INTERCONNECT
	depends on ARCH_QCOM || COMPILE_TEST
	default y

config INTERCONNECT_QCOM_MSM8916
	tristate "Qualcomm MSM8916 interconnect driver"
	depends on INTERCONNECT_QCOM
	help
	  This is a driver for the Qualcomm Network-on-Chip on msm8916-based platforms.
```
